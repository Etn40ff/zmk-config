## config/boards/shields/borg/Kconfig.shield
```kconfig
# Copyright (c) 2020 Pete Johanson
# SPDX-License-Identifier: MIT

config SHIELD_BORG_LEFT
    def_bool $(shields_list_contains,borg_left)

config SHIELD_BORG_RIGHT
    def_bool $(shields_list_contains,borg_right)
```

## config/west.yml
```yaml
manifest:
  remotes:
    - name: zmkfirmware
      url-base: https://github.com/zmkfirmware
    - name: badjeff
      url-base: https://github.com/badjeff

  projects:

    # Base zmk
    - name: zmk
      remote: zmkfirmware
      revision: v0.3
      import: app/west.yml

    # Module for PS/2 mouse & TP driver
    - name: kb_zmk_ps2_mouse_trackpoint_driver
      remote: badjeff
      revision: main

  self:
    path: config
```
